## config/boards/shields/rollow/Kconfig.shield
```kconfig
# Copyright (c) 2020 Pete Johanson
# SPDX-License-Identifier: MIT

config SHIELD_ROLLOW_LEFT
	def_bool $(shields_list_contains,rollow_left)

config SHIELD_ROLLOW_RIGHT
	def_bool $(shields_list_contains,rollow_right)
```

## config/west.yml
```yaml
manifest:
  remotes:
    - name: theol0403
      url-base: https://github.com/theol0403
  projects:
    - name: zmk
      remote: theol0403
      revision: main
      import: app/west.yml
  self:
    path: config
```
